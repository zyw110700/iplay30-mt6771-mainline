## drivers/net/wireless/mediatek/mt6631/Kconfig
```kconfig
# SPDX-License-Identifier: GPL-2.0-only

config MT6631_WLAN
	tristate "MediaTek MT6631 (CONSYS_6771) WLAN support"
	depends on ARCH_MEDIATEK || COMPILE_TEST
	depends on CFG80211
	select WIRELESS_EXT
	select WEXT_PRIV
	select CRC32
	help
	  Say Y or M here to build the vendor WLAN driver for the MediaTek
	  MT6631 connectivity combo chip.  On MT6771 (Helio P60/P70) the WiFi
	  MAC lives inside the CONNSYS subsystem and is driven over the AHB
	  HIF, not SDIO.

	  The driver is the MediaTek "gen3" WLAN stack (STA + P2P) with the
	  CONNSYS/WMT glue adapted to mainline.  It needs the WLAN firmware
	  blob (WIFI_RAM_CODE_6759) in /lib/firmware.

	  If unsure, say N.
```

## drivers/thermal/mediatek/Kconfig
```kconfig
config MTK_THERMAL
	tristate "MediaTek thermal drivers"
	depends on THERMAL_OF
	help
	  This is the option for MediaTek thermal software solutions.
	  Please enable corresponding options to get temperature
	  information from thermal sensors or turn on throttle
	  mechaisms for thermal mitigation.

if MTK_THERMAL

config MTK_SOC_THERMAL
	tristate "AUXADC temperature sensor driver for MediaTek SoCs"
	depends on HAS_IOMEM
	help
	  Enable this option if you want to get SoC temperature
	  information for MediaTek platforms.
	  This driver configures thermal controllers to collect
	  temperature via AUXADC interface.

config MTK_MT6771_THERMAL
	tristate "MT6771 AUXADC thermal controller (bring-up)"
	depends on HAS_IOMEM
	help
	  Read the two MT6771 thermal controller banks (little cluster, big
	  cluster, GPU, SoC, modem, ABB) without programming them.  The driver
	  stays inert until enabled through debugfs, so a wrong clock or sensor
	  mapping cannot hang the boot.

config MTK_LVTS_THERMAL
        tristate "LVTS Thermal Driver for MediaTek SoCs"
        depends on HAS_IOMEM
        help
          Enable this option if you want to get SoC temperature
          information for supported MediaTek platforms.
          This driver configures LVTS (Low Voltage Thermal Sensor)
          thermal controllers to collect temperatures via ASIF
          (Analog Serial Interface).

config MTK_LVTS_THERMAL_DEBUGFS
       bool "LVTS thermal debugfs"
       depends on MTK_LVTS_THERMAL && DEBUG_FS
       help
         Enable this option to debug the internals of the device driver.

endif
```
